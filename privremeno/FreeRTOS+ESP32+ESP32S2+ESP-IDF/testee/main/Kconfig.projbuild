## privremeno/FreeRTOS+ESP32+ESP32S2+ESP-IDF/testee/main/Kconfig.projbuild
```kconfig
menu "Testee Configuration"

    orsource "$IDF_PATH/examples/common_components/env_caps/$IDF_TARGET/Kconfig.env_caps"

    config REQUEST_PIN
        int "GPIO input pin: REQUEST_PIN"
        range ENV_GPIO_RANGE_MIN ENV_GPIO_IN_RANGE_MAX
        default 5
        help
            GPIO pin number to be used as REQUEST_PIN.

    config RESPONSE_PIN
        int "GPIO output pin: RESPONSE_PIN"
        range ENV_GPIO_RANGE_MIN ENV_GPIO_OUT_RANGE_MAX
        default 18
        help
            GPIO pin number to be used as RESPONSE_PIN.

    config LED_PIN
        int "GPIO output pin: LED_PIN"
        range ENV_GPIO_RANGE_MIN ENV_GPIO_OUT_RANGE_MAX
        default 19
        help
            GPIO pin number to be used as LED_PIN.


endmenu
```

## privremeno/FreeRTOS+ESP32+ESP32S2+ESP-IDF/tester/main/Kconfig.projbuild
```kconfig
menu "Tester Configuration"

    orsource "$IDF_PATH/examples/common_components/env_caps/$IDF_TARGET/Kconfig.env_caps"

    config REQUEST_PIN
        int "GPIO output pin: REQUEST_PIN"
        range ENV_GPIO_RANGE_MIN ENV_GPIO_OUT_RANGE_MAX
        default 7
        help
            GPIO pin number to be used as REQUEST_PIN.

    config RESPONSE_PIN
        int "GPIO output pin: RESPONSE_PIN"
        range ENV_GPIO_RANGE_MIN  ENV_GPIO_IN_RANGE_MAX
        default 8
        help
            GPIO pin number to be used as RESPONSE_PIN.

    config LED_PIN
        int "GPIO output pin: LED_PIN"
        range ENV_GPIO_RANGE_MIN ENV_GPIO_OUT_RANGE_MAX
        default 9
        help
            GPIO pin number to be used as LED_PIN.

endmenu
```

## privremeno/thunder-detector/main/Kconfig.projbuild
```kconfig
choice BUILD_EXAMPLE
    prompt "Examples"
    help
        Build the main firmware or one of the examples.
    default BUILD_FIRMWARE

    config BUILD_FIRMWARE
        bool "Main firmware"
    config EXAMPLE_RECORDER
        bool "Microphone WAV recording to SD card"
endchoice
```
